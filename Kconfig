## Kconfig
```kconfig
# SPDX-License-Identifier: GPL-2.0-only

menu "Quantum Drivers"

source "drivers/modules/hw_registers/Kconfig"
source "drivers/modules/my_driver/Kconfig"

endmenu
```

## demo-module/Kconfig
```kconfig
# SPDX-License-Identifier: GPL-2.0-only

config DEMO_MODULE
    tristate "Quantum Demo module Driver"
    depends on ARM64
    default m
    help
      This driver provides buildroot pacakge build demo
```

## hw_registers/Kconfig
```kconfig
# SPDX-License-Identifier: GPL-2.0-only

config HW_REGISTERS
    tristate "Quantum Hardware Registers Driver"
    depends on ARM64
    default m
    help
      This is a sample driver for hardware register access.
      Select this to build the Quantum hardware registers driver
      as a module (m) or built-in (y).
```

## memmap/Kconfig
```kconfig
# SPDX-License-Identifier: GPL-2.0-only

config MEMMAP_MODULE
    tristate "Quantum Memmap Memory Driver"
    depends on ARM64
    default m
    help
      This driver provides block device access to reserved memory regions.
      It can map physical memory ranges as block devices for use as
      temporary storage (e.g., memdisk at 0x78000000).

      Select this to build the memmap driver as a module (m) or built-in (y).

      Usage:
        insmod memmap.ko memmap=256M\$0x78000000
        mount /dev/memblock0 /mnt/memdisk
```

## my_driver/Kconfig
```kconfig
# SPDX-License-Identifier: GPL-2.0-only

config MY_DRIVER
    tristate "Quantum My Device Driver"
    depends on ARM64
    default m
    help
      This is a sample custom device driver.
      Select this to build the Quantum my device driver
      as a module (m) or built-in (y).
```
